## software/components/telemetry_link/Kconfig.projbuild
```kconfig
menu "Vehicle telemetry"

config DEMO_WIFI_SSID
    string "Wi-Fi SSID"
    default ""
    help
        SSID of the Wi-Fi network used to publish telemetry.

config DEMO_WIFI_PASSWORD
    string "Wi-Fi password"
    default ""
    help
        Password for the Wi-Fi network. Keep the generated sdkconfig private.

config DEMO_MQTT_BROKER_URI
    string "MQTT broker URI"
    default ""
    help
        MQTT broker URI, for example mqtt://192.168.1.10:1883. Prefer a
        private broker because telemetry can include GPS coordinates.

endmenu
```
